/dts-v1/;
/plugin/;

#include "AI2205-8550-EVB-camera-overlay.dts"
/ {
	model = "Qualcomm Technologies, Inc. ASUS AI2205 8550 CAMERA SR1";
	compatible = "qcom,kalama";
	qcom,msm-id = <519 0x10000>, <536 0x10000>, <519 0x20000>, <536 0x20000>;
	qcom,board-id = <40 0>;
};
