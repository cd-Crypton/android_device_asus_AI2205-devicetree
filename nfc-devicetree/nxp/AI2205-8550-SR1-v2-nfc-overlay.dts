/dts-v1/;
/plugin/;

#include "AI2205-8550-EVB-v2-nfc-overlay.dts"
/ {
	model = "Qualcomm Technologies, Inc. ASUS AI2205 8550 NFC SR1";
	compatible = "qcom,kalama-mtp", "qcom,kalama", "qcom,mtp";
	qcom,msm-id = <519 0x20000>, <536 0x20000>;
	qcom,board-id = <40 0>;
};
